#include "WeatherRenderer.h"

#include <stdio.h>
#include <Adafruit_GFX.h>

#include "DeviceConfiguration.h"
#include "P3RGB64x64MatrixPanel.h"
#include "WeatherClient.h"

namespace {
constexpr uint8_t kColorMaximum = 15;
constexpr uint8_t kNoColor = 0;
constexpr uint16_t kWeatherCategoryDivisor = 100;
constexpr uint16_t kClearSkyWeatherId = 800;
constexpr uint16_t kThunderstormCategory = 2;
constexpr uint16_t kDrizzleCategory = 3;
constexpr uint16_t kRainCategory = 5;
constexpr uint16_t kSnowCategory = 6;
constexpr uint16_t kCloudCategory = 8;
constexpr uint8_t kTemperatureBufferSize = 16;
constexpr char kTemperatureFormat[] = "%2.1f";
constexpr char kCurrentTemperatureFormat[] = "Now:%2.1f";

const uint8_t kSunnyIcon[] PROGMEM = {0xFF, 0xFE, 0x7F, 0xFF, 0xFF, 0xFE, 0x7F, 0xFF, 0xFF, 0x7E, 0x7E, 0xFF, 0xFF,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 0x7F, 0xFF};
const uint8_t kCloudIcon[] PROGMEM = {0xFF, 0xFF, 0xFF, 0xFF, 0xFF, 0xFF, 0xFF, 0xFF, 0xFF, 0xFF, 0xFF, 0xFF, 0xFF,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 0xFF, 0xFF};
const uint8_t kRainIcon[] PROGMEM = {0xFF, 0xFF, 0xFF, 0xFF, 0xFF, 0xFF, 0xFF, 0xFF, 0xFF, 0xFF, 0xFF, 0xFF, 0xFF,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 0xFF, 0xFF};
const uint8_t kThunderIcon[] PROGMEM = {0xFF, 0xF8, 0x7F, 0xFF, 0xFF, 0xE0, 0x1F, 0xFF, 0xFF, 0x9F, 0xC7, 0xFF, 0xFF,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 0xFF, 0xFF};
const uint8_t kSnowIcon[] PROGMEM = {0xFF, 0xFF, 0xFF, 0xFF, 0xFF, 0xFF, 0xFF, 0xFF, 0xFF, 0xE0, 0x3F, 0xFF, 0xFF,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 0xFF, 0xFF};
}

WeatherRenderer::WeatherRenderer(P3RGB64x64MatrixPanel& panel) : _panel(panel) {}

void WeatherRenderer::begin() {
  _panel.setTextSize(DeviceConfiguration::kTextSize);
  _panel.setTextWrap(false);
}

uint16_t WeatherRenderer::textColorForWeather(uint weatherId) {
  switch (weatherId / kWeatherCategoryDivisor) {
    case kThunderstormCategory:
      return _panel.color444(kColorMaximum, kColorMaximum, kNoColor);
    case kDrizzleCategory:
    case kRainCategory:
      return _panel.color444(kNoColor, kColorMaximum, kColorMaximum);
    case kSnowCategory:
      return _panel.color444(kColorMaximum, kColorMaximum, kColorMaximum);
    case kCloudCategory:
      return weatherId == kClearSkyWeatherId
                 ? _panel.color444(kColorMaximum, kNoColor, kNoColor)
                 : _panel.color444(kColorMaximum, kColorMaximum, kColorMaximum);
    default:
      return _panel.color444(kColorMaximum, kColorMaximum, kColorMaximum);
  }
}

uint16_t WeatherRenderer::iconColorForWeather(uint weatherId) {
  switch (weatherId / kWeatherCategoryDivisor) {
    case kThunderstormCategory:
      return _panel.color444(kColorMaximum, kColorMaximum, kNoColor);
    case kDrizzleCategory:
    case kRainCategory:
      return _panel.color444(kNoColor, kNoColor, kColorMaximum);
    case kCloudCategory:
      return weatherId == kClearSkyWeatherId
                 ? _panel.color444(kColorMaximum, kNoColor, kNoColor)
                 : _panel.color444(kColorMaximum, kColorMaximum, kColorMaximum);
    case kSnowCategory:
    default:
      return _panel.color444(kColorMaximum, kColorMaximum, kColorMaximum);
  }
}

const uint8_t* WeatherRenderer::iconForWeather(uint weatherId) const {
  switch (weatherId / kWeatherCategoryDivisor) {
    case kThunderstormCategory:
      return kThunderIcon;
    case kDrizzleCategory:
    case kRainCategory:
      return kRainIcon;
    case kSnowCategory:
      return kSnowIcon;
    case kCloudCategory:
      return weatherId == kClearSkyWeatherId ? kSunnyIcon : kCloudIcon;
    default:
      return kCloudIcon;
  }
}

void WeatherRenderer::renderWeather(WeatherClient& weather) {
  _panel.fillScreen(_panel.color444(kNoColor, kNoColor, kNoColor));
  _panel.setCursor(0, DeviceConfiguration::kTextSize *
                          DeviceConfiguration::kTextLineHeightPixels *
                          DeviceConfiguration::kWeatherHourLineIndex * 
                          0.5);
  _panel.setTextSize(DeviceConfiguration::kTextSize);
  _panel.setTextColor(_panel.color444(kColorMaximum, kColorMaximum, kColorMaximum));
  _panel.println(weather.getDisplayLabel().c_str());

  // _panel.setCursor(0, DeviceConfiguration::kTextSize *
  //                         DeviceConfiguration::kTextLineHeightPixels *
  //                         DeviceConfiguration::kWeatherHourLineIndex);
  // _panel.println(weather.getForecastHour().c_str());

  _panel.setCursor(0, DeviceConfiguration::kTextSize *
                          DeviceConfiguration::kTextLineHeightPixels *
                          DeviceConfiguration::kWeatherNameLineIndex);
  _panel.setTextColor(textColorForWeather(weather.getWeatherId()));
  _panel.println(weather.getWeather().c_str());

  char temperature[kTemperatureBufferSize] = {};

// 気温を描画する開始座標
int16_t x = 0;
int16_t y = DeviceConfiguration::kTextSize * DeviceConfiguration::kTextLineHeightPixels * DeviceConfiguration::kMaximumTemperatureLineIndex;

if (weather.getIsForecastMode()) {
  // --- 1. 最高気温の数字だけを描画 ---
  _panel.setCursor(x, y);
  _panel.setTextColor(_panel.color444(kColorMaximum, kNoColor, kNoColor)); // 赤
  snprintf(temperature, sizeof(temperature), kTemperatureFormat, weather.getMaxTemperature());
  _panel.print(temperature); 

  // --- 2. スラッシュの描画 ---
  _panel.setTextColor(_panel.color444(kColorMaximum, kColorMaximum, kColorMaximum)); // 白
  _panel.print("/");

  // --- 3. 最低気温の数字を描画 ---
  _panel.setTextColor(_panel.color444(kNoColor, kColorMaximum, kColorMaximum)); // 青
  snprintf(temperature, sizeof(temperature), kTemperatureFormat, weather.getMinTemperature());
  _panel.println(temperature);

} else {
  // 通常モード（最高気温のみ）
  _panel.setCursor(x, y);
  _panel.setTextColor(_panel.color444(kColorMaximum, kNoColor, kNoColor));
  snprintf(temperature, sizeof(temperature), kTemperatureFormat, weather.getMaxTemperature());
  _panel.print(temperature);

  int16_t currentX = _panel.getCursorX();
  _panel.drawRect(currentX + 1, y + 1, 2, 2, _panel.color444(kColorMaximum, kNoColor, kNoColor));
  _panel.setCursor(currentX + 4, y);
  _panel.println("C");
}

  _panel.drawBitmap(DeviceConfiguration::kWeatherIconX,
                    DeviceConfiguration::kWeatherIconY,
                    iconForWeather(weather.getWeatherId()),
                    DeviceConfiguration::kWeatherIconSize,
                    DeviceConfiguration::kWeatherIconSize,
                    _panel.color444(kNoColor, kNoColor, kNoColor),
                    iconColorForWeather(weather.getWeatherId()));
}

void WeatherRenderer::renderError() {
  _panel.fillScreen(_panel.color444(kNoColor, kNoColor, kNoColor));
  _panel.setCursor(0, 0);
  _panel.setTextSize(DeviceConfiguration::kTextSize);
  _panel.setTextColor(_panel.color444(kColorMaximum, kNoColor, kNoColor));
  _panel.println("Error");
}

void WeatherRenderer::drawNightIndicator(bool visible, uint8_t brightness) {
  _panel.fillScreen(_panel.color444(kNoColor, kNoColor, kNoColor));
  if (visible) {
    _panel.fillRect(DeviceConfiguration::kNightIndicatorX,
                    DeviceConfiguration::kNightIndicatorY,
                    DeviceConfiguration::kNightIndicatorSize,
                    DeviceConfiguration::kNightIndicatorSize,
                    _panel.color444(brightness,
                                    kNoColor, kNoColor));
  }
}
